AUTOSAR XML (schema 4-0-3)
package /Ecuc
  module config Os: ecuc-def-edition=4.2.0, implementation-config-variant=VARIANT-PRE-COMPILE
    OSAP_for_IciInt0 (OsApplication): OsTrusted=true, OsApplicationCoreAssignment=0, OsAppIsrRef=IciInt0
      OsApplicationHooks: OsAppErrorHook=false, OsAppShutdownHook=false, OsAppStartupHook=false
    IciInt0 (OsIsr): OsIsrInterruptNumber=INTNO_ICI0, OsIsrInterruptPriority=INTPRI_ICI0, OsIsrStackSize=592, OsIsrCategory=CATEGORY_2, OsIsrInterruptSource=ENABLE
    OSAP_for_IciInt1 (OsApplication): OsTrusted=true, OsApplicationCoreAssignment=1, OsAppIsrRef=IciInt1
      OsApplicationHooks: OsAppErrorHook=false, OsAppShutdownHook=false, OsAppStartupHook=false
    IciInt1 (OsIsr): OsIsrInterruptNumber=INTNO_ICI1, OsIsrInterruptPriority=INTPRI_ICI1, OsIsrStackSize=592, OsIsrCategory=CATEGORY_2, OsIsrInterruptSource=ENABLE
