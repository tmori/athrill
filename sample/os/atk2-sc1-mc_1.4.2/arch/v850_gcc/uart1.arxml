AUTOSAR XML (schema 4-0-3)
package /Ecuc
  module config Os: ecuc-def-edition=4.2.0, implementation-config-variant=VARIANT-PRE-COMPILE
    OSAP_for_RxHwSerialInt1 (OsApplication): OsTrusted=true, OsApplicationCoreAssignment=1, OsAppIsrRef=RxHwSerialInt1
      OsApplicationHooks: OsAppErrorHook=false, OsAppShutdownHook=false, OsAppStartupHook=false
    RxHwSerialInt1 (OsIsr):
      OsIsrInterruptNumber = INTNO_SIO_UART1
      OsIsrInterruptPriority = INTPRI_SIO_UART1
      OsIsrStackSize = 592
      OsIsrCategory = CATEGORY_2
      OsIsrInterruptSource = ENABLE
