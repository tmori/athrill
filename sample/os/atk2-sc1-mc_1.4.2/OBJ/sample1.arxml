AUTOSAR XML (schema 4-0-3)
standard types defined: uint8
package /Ecuc
  module config Os: ecuc-def-edition=4.2.0, implementation-config-variant=VARIANT-PRE-COMPILE
    OsInclude: OsIncludeFileName=sample1.h
    3 x OsAppMode:
      AppMode{1..3}
    OsOS: OsNumberOfCores=2, OsStackMonitoring=false, OsUseGetServiceId=true, OsUseParameterAccess=true, OsScalabilityClass=SC1, OsStatus=EXTENDED
      OsHooks: OsErrorHook=true, OsPostTaskHook=true, OsPreTaskHook=true, OsProtectionHook=true, OsShutdownHook=true, OsStartupHook=true
      OsHookStack: OsHookStackSize=512, OsHookStackCoreAssignment=0
    4 x OsEvent:
      MainEvt0
      MainEvt1
      T2Evt
      T3Evt: OsEventMask=65536
    SampleCnt (OsCounter): OsCounterMaxAllowedValue=99, OsCounterMinCycle=10, OsCounterTicksPerBase=10, OsCounterType=SOFTWARE
    4 x OsTask, all with OsTaskStackSize=592:
      MainTask: OsTaskActivation=1, OsTaskPriority=14, OsTaskSchedule=NON, OsTaskEventRef=MainEvt0, OsTaskEventRef=IocEvt
        OsTaskAutostart: OsTaskAppModeRef=AppMode1, OsTaskAppModeRef=AppMode2, OsTaskAppModeRef=AppMode3
      HighPriorityTask: OsTaskActivation=1, OsTaskPriority=15, OsTaskSchedule=FULL
      NonPriTask: OsTaskActivation=8, OsTaskPriority=1, OsTaskSchedule=NON
      Task1: OsTaskActivation=8, OsTaskPriority=4, OsTaskSchedule=FULL, OsTaskResourceRef=CntRes, OsTaskResourceRef=TskLevelRes
        OsTaskAutostart: OsTaskAppModeRef=AppMode2
    T6Evt (OsEvent)
    Task2 (OsTask):
      OsTaskActivation = 1
      OsTaskPriority = 7
      OsTaskStackSize = 592
      OsTaskSchedule = FULL
      OsTaskResourceRef = CntRes
      OsTaskResourceRef = TskLevelRes
      OsTaskEventRef = T2Evt
    5 x OsAlarm:
      MainCycArm0: OsAlarmCounterRef=MAIN_HW_COUNTER_CORE0
        OsAlarmAction
          OsAlarmSetEvent: OsAlarmSetEventTaskRef=MainTask, OsAlarmSetEventRef=MainEvt0
      ActTskArm: OsAlarmCounterRef=MAIN_HW_COUNTER_CORE0
        OsAlarmAction
          OsAlarmActivateTask: OsAlarmActivateTaskRef=Task1
      SetEvtArm: OsAlarmCounterRef=MAIN_HW_COUNTER_CORE0
        OsAlarmAction
          OsAlarmSetEvent: OsAlarmSetEventTaskRef=Task3, OsAlarmSetEventRef=T3Evt
      CallBackArm: OsAlarmCounterRef=MAIN_HW_COUNTER_CORE0
        OsAlarmAction
          OsAlarmCallback: OsAlarmCallbackName=SysTimerAlmCb
      MainCycArm1: OsAlarmCounterRef=MAIN_HW_COUNTER_CORE1
        OsAlarmAction
          OsAlarmSetEvent: OsAlarmSetEventTaskRef=IdleTask, OsAlarmSetEventRef=MainEvt1
    3 x OsEvent:
      T7Evt
      T8Evt
      IocEvt
    SmpSpin (OsSpinlock): OsSpinlockLockMethod=LOCK_NOTHING, OsSpinlockAccessingApplication=OSAP_CORE0, OsSpinlockAccessingApplication=OSAP_CORE1
    IOC (OsIoc)
      IOC_QUE (OsIocCommunication): OsIocBufferLength=3
        IOC_QUE_DATA (OsIocDataProperties): OsIocInitValue=1U, OsIocDataTypeRef=uint8
        IOC_QUE_RCV (OsIocReceiverProperties): OsIocFunctionImplementationKind=FUNCTION, OsIocReceivingOsApplicationRef=OSAP_CORE1
        IOC_QUE_SND0 (OsIocSenderProperties): OsIocSenderId=0, OsIocFunctionImplementationKind=FUNCTION, OsIocSendingOsApplicationRef=OSAP_CORE0
        IOC_QUE_SND1 (OsIocSenderProperties): OsIocSenderId=1, OsIocFunctionImplementationKind=FUNCTION, OsIocSendingOsApplicationRef=OSAP_CORE0
      IOC_DEQUE (OsIocCommunication)
        3 x OsIocDataProperties, all with OsIocDataTypeRef=uint8:
          IOC_DEQUE_DATA0: OsIocDataPropertyIndex=0, OsIocInitValue=0U
          IOC_DEQUE_DATA1: OsIocDataPropertyIndex=1, OsIocInitValue=10U
          IOC_DEQUE_DATA2: OsIocDataPropertyIndex=2, OsIocInitValue=20U
        IOC_DEQUE_RCV (OsIocReceiverProperties): OsIocFunctionImplementationKind=FUNCTION, OsIocReceivingOsApplicationRef=OSAP_CORE1
        IOC_DEQUE_SND (OsIocSenderProperties): OsIocFunctionImplementationKind=FUNCTION, OsIocSendingOsApplicationRef=OSAP_CORE0
    Task3 (OsTask): OsTaskActivation=1, OsTaskPriority=12, OsTaskStackSize=592, OsTaskSchedule=FULL, OsTaskResourceRef=CntRes, OsTaskEventRef=T3Evt
      OsTaskAutostart: OsTaskAppModeRef=AppMode3
    Task4 (OsTask):
      OsTaskActivation = 5
      OsTaskPriority = 6
      OsTaskStackSize = 592
      OsTaskSchedule = FULL
      OsTaskResourceRef = GroupRes
      OsTaskResourceRef = CntRes
      OsTaskResourceRef = TskLevelRes
    TskLevelRes (OsResource): OsResourceProperty=STANDARD
    CntRes (OsResource): OsResourceProperty=STANDARD
    SampleAlm (OsAlarm): OsAlarmCounterRef=SampleCnt
      OsAlarmAction
        OsAlarmCallback: OsAlarmCallbackName=SampleAlmCb
      OsAlarmAutostart:
        OsAlarmAlarmTime = 10
        OsAlarmCycleTime = 10
        OsAlarmAutostartType = ABSOLUTE
        OsAlarmAppModeRef = AppMode{1..3}
    scheduletable1 (OsScheduleTable): OsScheduleTableDuration=60, OsScheduleTableRepeating=true, OsScheduleTableCounterRef=SchtblSampleCnt
      OsScheduleTableExpiryPoint_0 (OsScheduleTableExpiryPoint): OsScheduleTblExpPointOffset=10
        3 x OsScheduleTableTaskActivation:
          OsScheduleTableTaskActivation_0: OsScheduleTableActivateTaskRef=Task6
          OsScheduleTableTaskActivation_1: OsScheduleTableActivateTaskRef=Task7
          OsScheduleTableTaskActivation_2: OsScheduleTableActivateTaskRef=Task8
      OsScheduleTableExpiryPoint_1 (OsScheduleTableExpiryPoint): OsScheduleTblExpPointOffset=20
        3 x OsScheduleTableEventSetting:
          OsScheduleTableEventSetting_0: OsScheduleTableSetEventRef=T6Evt, OsScheduleTableSetEventTaskRef=Task6
          OsScheduleTableEventSetting_1: OsScheduleTableSetEventRef=T7Evt, OsScheduleTableSetEventTaskRef=Task7
          OsScheduleTableEventSetting_2: OsScheduleTableSetEventRef=T8Evt, OsScheduleTableSetEventTaskRef=Task8
      OsScheduleTableSync: OsScheduleTblSyncStrategy=NONE
    Task5 (OsTask):
      OsTaskActivation = 5
      OsTaskPriority = 9
      OsTaskStackSize = 592
      OsTaskSchedule = FULL
      OsTaskResourceRef = GroupRes
      OsTaskResourceRef = CntRes
      OsTaskResourceRef = TskLevelRes
    GroupRes (OsResource): OsResourceProperty=INTERNAL
    IocTask1 (OsTask): OsTaskActivation=1, OsTaskPriority=9, OsTaskStackSize=592, OsTaskSchedule=FULL, OsTaskEventRef=IocEvt
    IocTask2 (OsTask): OsTaskActivation=1, OsTaskPriority=9, OsTaskStackSize=592, OsTaskSchedule=FULL, OsTaskEventRef=IocEvt
    scheduletable2 (OsScheduleTable): OsScheduleTableDuration=50, OsScheduleTableRepeating=true, OsScheduleTableCounterRef=SchtblSampleCnt
      3 x OsScheduleTableExpiryPoint:
        OsScheduleTableExpiryPoint_0: OsScheduleTblExpPointOffset=20
          OsScheduleTableTaskActivation_0 (OsScheduleTableTaskActivation): OsScheduleTableActivateTaskRef=Task8
          OsScheduleTableTaskActivation_1 (OsScheduleTableTaskActivation): OsScheduleTableActivateTaskRef=Task7
        OsScheduleTableExpiryPoint_1: OsScheduleTblExpPointOffset=30
          OsScheduleTableEventSetting_0 (OsScheduleTableEventSetting): OsScheduleTableSetEventRef=T8Evt, OsScheduleTableSetEventTaskRef=Task8
        OsScheduleTableExpiryPoint_2: OsScheduleTblExpPointOffset=40
          OsScheduleTableEventSetting_0 (OsScheduleTableEventSetting): OsScheduleTableSetEventRef=T7Evt, OsScheduleTableSetEventTaskRef=Task7
      OsScheduleTableSync: OsScheduleTblSyncStrategy=NONE
    Task6 (OsTask): OsTaskActivation=1, OsTaskPriority=13, OsTaskStackSize=592, OsTaskSchedule=NON, OsTaskEventRef=T6Evt
    SampleAlm1 (OsAlarm): OsAlarmCounterRef=SampleCnt2
      OsAlarmAction
        OsAlarmIncrementCounter: OsAlarmIncrementCounterRef=SampleCnt3
      OsAlarmAutostart:
        OsAlarmAlarmTime = 10
        OsAlarmCycleTime = 10
        OsAlarmAutostartType = ABSOLUTE
        OsAlarmAppModeRef = AppMode{1..3}
    Task7 (OsTask): OsTaskActivation=1, OsTaskPriority=13, OsTaskStackSize=592, OsTaskSchedule=NON, OsTaskEventRef=T7Evt
    SampleCnt2 (OsCounter): OsCounterMaxAllowedValue=99, OsCounterMinCycle=10, OsCounterTicksPerBase=10, OsCounterType=SOFTWARE
    SampleAlm2 (OsAlarm): OsAlarmCounterRef=SampleCnt3
      OsAlarmAction
        OsAlarmCallback: OsAlarmCallbackName=SampleAlmCb2
      OsAlarmAutostart:
        OsAlarmAlarmTime = 10
        OsAlarmCycleTime = 10
        OsAlarmAutostartType = ABSOLUTE
        OsAlarmAppModeRef = AppMode{1..3}
    Task8 (OsTask): OsTaskActivation=1, OsTaskPriority=13, OsTaskStackSize=592, OsTaskSchedule=NON, OsTaskEventRef=T8Evt
    SampleCnt3 (OsCounter): OsCounterMaxAllowedValue=99, OsCounterMinCycle=10, OsCounterTicksPerBase=10, OsCounterType=SOFTWARE
    SchtblSampleCnt (OsCounter): OsCounterMaxAllowedValue=99, OsCounterMinCycle=10, OsCounterTicksPerBase=10, OsCounterType=SOFTWARE
    4 x OsTask, all with OsTaskStackSize=592, OsTaskSchedule=FULL:
      IdleTask: OsTaskActivation=1, OsTaskPriority=5, OsTaskEventRef=MainEvt1
        OsTaskAutostart: OsTaskAppModeRef=AppMode1, OsTaskAppModeRef=AppMode2, OsTaskAppModeRef=AppMode3
      Task9: OsTaskActivation=8, OsTaskPriority=6
      IocTask3: OsTaskActivation=1, OsTaskPriority=9, OsTaskEventRef=IocEvt
      IocTask4: OsTaskActivation=1, OsTaskPriority=9, OsTaskEventRef=IocEvt
    4 x OsInterCoreInterrupt, all with OsInterCoreInterruptStackSize=512:
      Core0_ICI_1
      Core0_ICI_2
      Core1_ICI_1
      Core1_ICI_2
    OSAP_CORE0 (OsApplication):
      OsTrusted = true
      OsApplicationCoreAssignment = 0
      OsAppTaskRef = MainTask
      OsAppTaskRef = HighPriorityTask
      OsAppTaskRef = NonPriTask
      OsAppTaskRef = Task{1..5}
      OsAppTaskRef = IocTask1
      OsAppTaskRef = IocTask2
      OsAppTaskRef = Task{6..8}
      OsAppCounterRef = SampleCnt
      OsAppCounterRef = SampleCnt2
      OsAppCounterRef = SampleCnt3
      OsAppCounterRef = SchtblSampleCnt
      OsAppAlarmRef = MainCycArm0
      OsAppAlarmRef = ActTskArm
      OsAppAlarmRef = SetEvtArm
      OsAppAlarmRef = CallBackArm
      OsAppAlarmRef = SampleAlm
      OsAppAlarmRef = SampleAlm1
      OsAppAlarmRef = SampleAlm2
      OsAppScheduleTableRef = scheduletable1
      OsAppScheduleTableRef = scheduletable2
      OsAppInterCoreInterruptRef = Core0_ICI_1
      OsAppInterCoreInterruptRef = Core0_ICI_2
    OSAP_CORE1 (OsApplication):
      OsTrusted = true
      OsApplicationCoreAssignment = 1
      OsAppTaskRef = IdleTask
      OsAppTaskRef = Task9
      OsAppTaskRef = IocTask3
      OsAppTaskRef = IocTask4
      OsAppAlarmRef = MainCycArm1
      OsAppInterCoreInterruptRef = Core1_ICI_1
      OsAppInterCoreInterruptRef = Core1_ICI_2
