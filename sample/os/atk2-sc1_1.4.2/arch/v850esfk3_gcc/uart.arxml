AUTOSAR XML (schema 4-0-3)
package /Ecuc
  module config Os: ecuc-def-edition=4.2.0, implementation-config-variant=VARIANT-PRE-COMPILE
    OSAP_for_RxHwSerialInt (OsApplication): OsAppIsrRef=RxHwSerialInt
      OsApplicationHooks: OsAppErrorHook=false, OsAppShutdownHook=false, OsAppStartupHook=false
    RxHwSerialInt (OsIsr): OsIsrInterruptNumber=36, OsIsrInterruptPriority=2, OsIsrStackSize=592, OsIsrCategory=CATEGORY_2, OsIsrInterruptSource=ENABLE
