AUTOSAR XML (schema 4-0-3)
package /Ecuc
  module config Os: ecuc-def-edition=4.2.0, implementation-config-variant=VARIANT-PRE-COMPILE
    OsInclude: OsIncludeFileName=target_hw_counter.h
    MAIN_HW_COUNTER (OsCounter):
      OsCounterMaxAllowedValue = 32767
      OsCounterMinCycle = 1
      OsCounterTicksPerBase = 10
      OsSecondsPerTick = 0.0001
      OsCounterType = HARDWARE
      OsCounterIsrRef = C2ISR_for_MAIN_HW_COUNTER
    C2ISR_for_MAIN_HW_COUNTER (OsIsr): OsIsrInterruptNumber=22, OsIsrInterruptPriority=1, OsIsrStackSize=512, OsIsrCategory=CATEGORY_2, OsIsrInterruptSource=ENABLE
