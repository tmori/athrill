AUTOSAR XML (schema 4-0-3)
package /Ecuc
  module config Os: ecuc-def-edition=4.2.0, implementation-config-variant=VARIANT-PRE-COMPILE
    TRUSTED_OSAP_for_RxHwSerialInt (OsApplication): OsTrusted=true, OsApplicationCoreAssignment=0, OsAppIsrRef=RxHwSerialInt0
    RxHwSerialInt0 (OsIsr):
      OsIsrInterruptNumber = INTNO_SIO_CORE0
      OsIsrInterruptPriority = INTPRI_SIO_CORE0
      OsIsrStackSize = 592
      OsIsrCategory = CATEGORY_2
      OsIsrInterruptSource = ENABLE
    OSAP_for_RxHwSerialInt1 (OsApplication): OsApplicationCoreAssignment=1, OsTrusted=true, OsAppIsrRef=RxHwSerialInt1
    RxHwSerialInt1 (OsIsr):
      OsIsrInterruptNumber = INTNO_SIO_CORE1
      OsIsrInterruptPriority = INTPRI_SIO_CORE1
      OsIsrStackSize = 592
      OsIsrCategory = CATEGORY_2
      OsIsrInterruptSource = ENABLE
