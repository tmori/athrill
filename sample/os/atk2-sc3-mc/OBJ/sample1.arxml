AUTOSAR XML (schema 4-0-3)
standard types defined: uint8
package /Ecuc
  module config Os: ecuc-def-edition=4.2.0, implementation-config-variant=VARIANT-PRE-COMPILE
    Task6 (OsTask): OsTaskStackSize=512, OsTaskSchedule=FULL, OsTaskStackStartAddress=stack_00, OsTaskActivation=1, OsTaskPriority=9, OsTaskEventRef=T6Evt
      OsTaskAutostart: OsTaskAppModeRef=AppMode1, OsTaskAppModeRef=AppMode2, OsTaskAppModeRef=AppMode3
    Task10 (OsTask): OsTaskSystemStackSize=512, OsTaskStackSize=512, OsTaskSchedule=NON, OsTaskActivation=1, OsTaskPriority=13, OsTaskEventRef=T10Evt
    T3Evt (OsEvent): OsEventMask=65536
    TT_osap0 (OsApplication):
      OsTrusted = true
      OsApplicationCoreAssignment = 0
      OsAppMemoryModuleRef = banner
      OsAppMemoryModuleRef = log_output
      OsAppTaskRef = NonPriTask
      OsAppTaskRef = Task6
      OsAppTaskRef = Task7
      OsAppTaskRef = IocTask3
      OsAppAlarmRef = SetEvtArm2
      OsAppInterCoreInterruptRef = Core0_ICI_1
      OsAppInterCoreInterruptRef = Core0_ICI_2
      5 x OsApplicationTrustedFunction, all with OsTrustedFunctionStackSize=32:
        setiocevt2: OsTrustedFunctionName=TRUSTED_setiocevt2
        tfnt4: OsTrustedFunctionName=TRUSTED_tfnt4
        tfnt3: OsTrustedFunctionName=TRUSTED_tfnt3
        tfnt2: OsTrustedFunctionName=TRUSTED_tfnt2
        tfnt1: OsTrustedFunctionName=TRUSTED_tfnt1
    IocEvt (OsEvent)
    Task3 (OsTask):
      OsTaskSystemStackSize = 512
      OsTaskStackSize = 512
      OsTaskSchedule = FULL
      OsTaskActivation = 1
      OsTaskPriority = 12
      OsTaskResourceRef = CntRes
      OsTaskEventRef = T3Evt
      OsTaskAutostart: OsTaskAppModeRef=AppMode3
    GroupRes (OsResource): OsResourceProperty=INTERNAL, OsResourceAccessingApplication=TT_osap1
    TskLevelRes (OsResource): OsResourceProperty=STANDARD, OsResourceAccessingApplication=TT_osap1
    HighPriorityTask (OsTask): OsTaskSystemStackSize=512, OsTaskStackSize=512, OsTaskSchedule=FULL, OsTaskActivation=1, OsTaskPriority=15
    T10Evt (OsEvent)
    SmpSpin (OsSpinlock): OsSpinlockLockMethod=LOCK_NOTHING, OsSpinlockAccessingApplication=NT_osap0, OsSpinlockAccessingApplication=TT_osap1
    Core1_ICI_1 (OsInterCoreInterrupt): OsInterCoreInterruptStackSize=512, OsInterCoreInterruptInterruptSource=ENABLE
    Task15 (OsTask): OsTaskStackSize=512, OsTaskSchedule=FULL, OsTaskActivation=5, OsTaskPriority=11
      OsTaskAutostart: OsTaskAppModeRef=AppMode1, OsTaskAppModeRef=AppMode2, OsTaskAppModeRef=AppMode3
    SampleCnt3 (OsCounter): OsCounterMinCycle=10, OsCounterType=SOFTWARE, OsCounterMaxAllowedValue=99, OsCounterTicksPerBase=10
    IOC (OsIoc)
      IOC_DEQUE (OsIocCommunication)
        IOC_DEQUE_SND (OsIocSenderProperties): OsIocFunctionImplementationKind=FUNCTION, OsIocSendingOsApplicationRef=TT_osap1
        3 x OsIocDataProperties, all with OsIocDataTypeRef=uint8:
          IOC_DEQUE_DATA2: OsIocDataPropertyIndex=2, OsIocInitValue=20U
          IOC_DEQUE_DATA1: OsIocDataPropertyIndex=1, OsIocInitValue=10U
          IOC_DEQUE_DATA0: OsIocDataPropertyIndex=0, OsIocInitValue=0U
        IOC_DEQUE_RCV (OsIocReceiverProperties): OsIocFunctionImplementationKind=FUNCTION, OsIocReceivingOsApplicationRef=NT_osap0
      IOC_QUE (OsIocCommunication): OsIocBufferLength=3
        IOC_QUE_RCV (OsIocReceiverProperties): OsIocFunctionImplementationKind=FUNCTION, OsIocReceivingOsApplicationRef=TT_osap0
        IOC_QUE_DATA (OsIocDataProperties): OsIocInitValue=1U, OsIocDataTypeRef=uint8
        IOC_QUE_SND1 (OsIocSenderProperties): OsIocFunctionImplementationKind=FUNCTION, OsIocSenderId=1, OsIocSendingOsApplicationRef=NT_osap1
        IOC_QUE_SND0 (OsIocSenderProperties): OsIocFunctionImplementationKind=FUNCTION, OsIocSenderId=0, OsIocSendingOsApplicationRef=TT_osap1
    T8Evt (OsEvent)
    Core0_ICI_1 (OsInterCoreInterrupt): OsInterCoreInterruptStackSize=512, OsInterCoreInterruptInterruptSource=ENABLE, OsInterCoreInterruptAccessingApplication=NT_osap1
    Task8 (OsTask): OsTaskSystemStackSize=512, OsTaskStackSize=512, OsTaskSchedule=NON, OsTaskActivation=1, OsTaskPriority=13, OsTaskEventRef=T8Evt
    OsInclude1 (OsInclude): OsIncludeFileName=sample1.h
    Task12 (OsTask): OsTaskSystemStackSize=0, OsTaskStackSize=512, OsTaskSchedule=FULL, OsTaskStackStartAddress=stack_1, OsTaskActivation=5, OsTaskPriority=8
    SetEvtArm (OsAlarm): OsAlarmCounterRef=MAIN_HW_COUNTER_CORE1
      OsAlarmAction
        OsAlarmSetEvent: OsAlarmSetEventRef=T3Evt, OsAlarmSetEventTaskRef=Task3
    IocTask2 (OsTask): OsTaskSystemStackSize=512, OsTaskStackSize=512, OsTaskSchedule=FULL, OsTaskActivation=1, OsTaskPriority=9, OsTaskEventRef=IocEvt
    AppMode2 (OsAppMode)
    Task5 (OsTask):
      OsTaskSystemStackSize = 512
      OsTaskStackSize = 512
      OsTaskSchedule = FULL
      OsTaskActivation = 5
      OsTaskPriority = 9
      OsTaskResourceRef = GroupRes
      OsTaskResourceRef = CntRes
      OsTaskResourceRef = TskLevelRes
    T9Evt (OsEvent)
    NonPriTask (OsTask): OsTaskSystemStackSize=512, OsTaskStackSize=512, OsTaskSchedule=NON, OsTaskActivation=8, OsTaskPriority=1
      OsTaskAutostart: OsTaskAppModeRef=AppMode1, OsTaskAppModeRef=AppMode2, OsTaskAppModeRef=AppMode3
    SchtblSampleCnt (OsCounter): OsCounterMinCycle=10, OsCounterType=SOFTWARE, OsCounterMaxAllowedValue=99, OsCounterTicksPerBase=10
    Task17 (OsTask): OsTaskStackSize=512, OsTaskSchedule=FULL, OsTaskActivation=1, OsTaskPriority=12
    sample2 (OsMemoryModule): OsMemoryModuleName=sample2.o, OsMemoryModuleExport=false
    Task2 (OsTask):
      OsTaskSystemStackSize = 512
      OsTaskStackSize = 512
      OsTaskSchedule = FULL
      OsTaskActivation = 1
      OsTaskPriority = 7
      OsTaskResourceRef = CntRes
      OsTaskResourceRef = TskLevelRes
      OsTaskEventRef = T2Evt
    scheduletable2 (OsScheduleTable): OsScheduleTableRepeating=true, OsScheduleTableDuration=50, OsScheduleTableCounterRef=SchtblSampleCnt
      OsScheduleTableSync: OsScheduleTblSyncStrategy=NONE
      3 x OsScheduleTableExpiryPoint:
        OsScheduleTableExpiryPoint_2: OsScheduleTblExpPointOffset=40
          OsScheduleTableEventSetting_0 (OsScheduleTableEventSetting): OsScheduleTableSetEventRef=T9Evt, OsScheduleTableSetEventTaskRef=Task9
        OsScheduleTableExpiryPoint_1: OsScheduleTblExpPointOffset=30
          OsScheduleTableEventSetting_0 (OsScheduleTableEventSetting): OsScheduleTableSetEventRef=T10Evt, OsScheduleTableSetEventTaskRef=Task10
        OsScheduleTableExpiryPoint_0: OsScheduleTblExpPointOffset=20
          OsScheduleTableTaskActivation_1 (OsScheduleTableTaskActivation): OsScheduleTableActivateTaskRef=Task9
          OsScheduleTableTaskActivation_0 (OsScheduleTableTaskActivation): OsScheduleTableActivateTaskRef=Task10
    SampleAlm2 (OsAlarm): OsAlarmCounterRef=SampleCnt3
      OsAlarmAutostart:
        OsAlarmAlarmTime = 10
        OsAlarmAutostartType = ABSOLUTE
        OsAlarmCycleTime = 10
        OsAlarmAppModeRef = AppMode{1..3}
      OsAlarmAction
        OsAlarmSetEvent: OsAlarmSetEventRef=MainEvt, OsAlarmSetEventTaskRef=MainTask
    NT_osap1 (OsApplication): OsTrusted=false, OsApplicationCoreAssignment=1, OsAppMemoryModuleRef=sample2, OsAppTaskRef=Task15, OsAppTaskRef=Task16, OsAppTaskRef=IocTask2
    Task14 (OsTask): OsTaskStackSize=512, OsTaskSchedule=FULL, OsTaskActivation=5, OsTaskPriority=10
    SampleCnt2 (OsCounter): OsCounterMinCycle=10, OsCounterType=SOFTWARE, OsCounterMaxAllowedValue=99, OsCounterTicksPerBase=10
    IocTask4 (OsTask): OsTaskSystemStackSize=512, OsTaskStackSize=512, OsTaskSchedule=FULL, OsTaskActivation=1, OsTaskPriority=9, OsTaskEventRef=IocEvt
    Task7 (OsTask): OsTaskStackSize=512, OsTaskSchedule=FULL, OsTaskActivation=5, OsTaskPriority=9
      OsTaskAutostart: OsTaskAppModeRef=AppMode1, OsTaskAppModeRef=AppMode2, OsTaskAppModeRef=AppMode3
    CntRes (OsResource): OsResourceProperty=STANDARD, OsResourceAccessingApplication=TT_osap1
    CORE1STANDARDREGION (OsStandardMemoryRegion): OsStandardMemoryCoreAssignment=1, OsStandardMemoryRamRegionRef=onchip_osdataram1, OsStandardMemoryRomRegionRef=ROM
    SampleCnt (OsCounter): OsCounterMinCycle=10, OsCounterType=SOFTWARE, OsCounterMaxAllowedValue=99, OsCounterTicksPerBase=10
    Task11 (OsTask): OsTaskSystemStackSize=0, OsTaskStackSize=512, OsTaskSchedule=FULL, OsTaskStackStartAddress=stack_1, OsTaskActivation=5, OsTaskPriority=9
    TT_osap1 (OsApplication):
      OsTrusted = true
      OsApplicationCoreAssignment = 1
      OsAppTaskRef = MainTask
      OsAppTaskRef = HighPriorityTask
      OsAppTaskRef = Task{1..5}
      OsAppTaskRef = IocTask1
      OsAppTaskRef = Task{8..12}
      OsAppScheduleTableRef = scheduletable1
      OsAppScheduleTableRef = scheduletable2
      OsAppAlarmRef = MainCycArm
      OsAppAlarmRef = ActTskArm
      OsAppAlarmRef = SetEvtArm
      OsAppAlarmRef = SampleAlm1
      OsAppAlarmRef = SampleAlm2
      OsAppInterCoreInterruptRef = Core1_ICI_1
      OsAppInterCoreInterruptRef = Core1_ICI_2
      OsAppCounterRef = SampleCnt
      OsAppCounterRef = SchtblSampleCnt
      OsAppCounterRef = SampleCnt2
      OsAppCounterRef = SampleCnt3
      setiocevt1 (OsApplicationTrustedFunction): OsTrustedFunctionName=TRUSTED_setiocevt1, OsTrustedFunctionStackSize=32
    IocTask1 (OsTask): OsTaskSystemStackSize=512, OsTaskStackSize=512, OsTaskSchedule=FULL, OsTaskActivation=1, OsTaskPriority=9, OsTaskEventRef=IocEvt
    AppMode1 (OsAppMode)
    MainEvt (OsEvent)
    Task4 (OsTask):
      OsTaskSystemStackSize = 512
      OsTaskStackSize = 512
      OsTaskSchedule = FULL
      OsTaskActivation = 5
      OsTaskPriority = 6
      OsTaskResourceRef = GroupRes
      OsTaskResourceRef = CntRes
      OsTaskResourceRef = TskLevelRes
    CORE0STANDARDREGION (OsStandardMemoryRegion): OsStandardMemoryCoreAssignment=0, OsStandardMemoryRamRegionRef=onchip_osdataram0, OsStandardMemoryRomRegionRef=ROM
    OsLinkSection: OsLinkSectionName=.stack_section, OsLinkSectionMemoryRegionRef=RAM
    Core1_ICI_2 (OsInterCoreInterrupt): OsInterCoreInterruptStackSize=512, OsInterCoreInterruptInterruptSource=ENABLE
    Task16 (OsTask): OsTaskStackSize=512, OsTaskSchedule=FULL, OsTaskActivation=5, OsTaskPriority=10
    sample1 (OsMemoryModule): OsMemoryModuleName=sample1.o, OsMemoryModuleExport=false
    Task1 (OsTask):
      OsTaskSystemStackSize = 512
      OsTaskStackSize = 512
      OsTaskSchedule = FULL
      OsTaskActivation = 8
      OsTaskPriority = 4
      OsTaskResourceRef = CntRes
      OsTaskResourceRef = TskLevelRes
      OsTaskAutostart: OsTaskAppModeRef=AppMode2
    MainTask (OsTask): OsTaskSystemStackSize=512, OsTaskStackSize=512, OsTaskSchedule=NON, OsTaskActivation=1, OsTaskPriority=14, OsTaskEventRef=MainEvt, OsTaskEventRef=IocEvt
      OsTaskAutostart: OsTaskAppModeRef=AppMode1, OsTaskAppModeRef=AppMode2, OsTaskAppModeRef=AppMode3
    MainCycArm (OsAlarm): OsAlarmCounterRef=MAIN_HW_COUNTER_CORE1
      OsAlarmAction
        OsAlarmSetEvent: OsAlarmSetEventRef=MainEvt, OsAlarmSetEventTaskRef=MainTask
    T6Evt (OsEvent)
    OsOS: OsStatus=EXTENDED, OsScalabilityClass=SC3, OsUseParameterAccess=true, OsStackMonitoring=true, OsUseGetServiceId=true, OsNumberOfCores=2
      OsHooks: OsShutdownHook=true, OsPostTaskHook=true, OsStartupHook=true, OsPreTaskHook=true, OsErrorHook=true, OsProtectionHook=true
      OsHookStack1 (OsHookStack): OsHookStackSize=1024, OsHookStackCoreAssignment=1
      OsHookStack0 (OsHookStack): OsHookStackSize=1024, OsHookStackCoreAssignment=0
    scheduletable1 (OsScheduleTable): OsScheduleTableRepeating=true, OsScheduleTableDuration=60, OsScheduleTableCounterRef=SchtblSampleCnt
      OsScheduleTableSync: OsScheduleTblSyncStrategy=NONE
      OsScheduleTableExpiryPoint_1 (OsScheduleTableExpiryPoint): OsScheduleTblExpPointOffset=20
        3 x OsScheduleTableEventSetting:
          OsScheduleTableEventSetting_2: OsScheduleTableSetEventRef=T10Evt, OsScheduleTableSetEventTaskRef=Task10
          OsScheduleTableEventSetting_1: OsScheduleTableSetEventRef=T9Evt, OsScheduleTableSetEventTaskRef=Task9
          OsScheduleTableEventSetting_0: OsScheduleTableSetEventRef=T8Evt, OsScheduleTableSetEventTaskRef=Task8
      OsScheduleTableExpiryPoint_0 (OsScheduleTableExpiryPoint): OsScheduleTblExpPointOffset=10
        3 x OsScheduleTableTaskActivation:
          OsScheduleTableTaskActivation_2: OsScheduleTableActivateTaskRef=Task10
          OsScheduleTableTaskActivation_1: OsScheduleTableActivateTaskRef=Task9
          OsScheduleTableTaskActivation_0: OsScheduleTableActivateTaskRef=Task8
    Core0_ICI_2 (OsInterCoreInterrupt): OsInterCoreInterruptStackSize=512, OsInterCoreInterruptInterruptSource=ENABLE
    log_output (OsMemoryModule): OsMemoryModuleName=log_output.o, OsMemoryModuleExport=false
    banner (OsMemoryModule): OsMemoryModuleName=banner.o, OsMemoryModuleExport=false
    Task9 (OsTask): OsTaskSystemStackSize=512, OsTaskStackSize=512, OsTaskSchedule=NON, OsTaskActivation=1, OsTaskPriority=13, OsTaskEventRef=T9Evt
    SampleAlm1 (OsAlarm): OsAlarmCounterRef=SampleCnt2
      OsAlarmAutostart:
        OsAlarmAlarmTime = 10
        OsAlarmAutostartType = ABSOLUTE
        OsAlarmCycleTime = 10
        OsAlarmAppModeRef = AppMode{1..3}
      OsAlarmAction
        OsAlarmIncrementCounter: OsAlarmIncrementCounterRef=SampleCnt3
    OsInclude2 (OsInclude): OsIncludeFileName=sample2.h
    NT_osap0 (OsApplication):
      OsTrusted = false
      OsApplicationCoreAssignment = 0
      OsAppMemoryModuleRef = sample1
      OsAppTaskRef = Task13
      OsAppTaskRef = Task14
      OsAppTaskRef = Task17
      OsAppTaskRef = IocTask4
    Task13 (OsTask): OsTaskStackSize=512, OsTaskSchedule=FULL, OsTaskActivation=5, OsTaskPriority=11
      OsTaskAutostart: OsTaskAppModeRef=AppMode1, OsTaskAppModeRef=AppMode2, OsTaskAppModeRef=AppMode3
    SetEvtArm2 (OsAlarm): OsAlarmCounterRef=MAIN_HW_COUNTER_CORE0
      OsAlarmAutostart:
        OsAlarmAlarmTime = TICK_FOR_10MS
        OsAlarmAutostartType = ABSOLUTE
        OsAlarmCycleTime = TICK_FOR_10MS
        OsAlarmAppModeRef = AppMode{1..3}
      OsAlarmAction
        OsAlarmSetEvent: OsAlarmSetEventRef=T6Evt, OsAlarmSetEventTaskRef=Task6
    ActTskArm (OsAlarm): OsAlarmCounterRef=MAIN_HW_COUNTER_CORE1
      OsAlarmAction
        OsAlarmActivateTask: OsAlarmActivateTaskRef=Task1
    T2Evt (OsEvent)
    IocTask3 (OsTask): OsTaskSystemStackSize=512, OsTaskStackSize=512, OsTaskSchedule=FULL, OsTaskActivation=1, OsTaskPriority=9, OsTaskEventRef=IocEvt
    AppMode3 (OsAppMode)
