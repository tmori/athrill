AUTOSAR XML (schema 4-0-3)
package /Ecuc
  module config Os: ecuc-def-edition=4.2.0, implementation-config-variant=VARIANT-PRE-COMPILE
    OsInclude: OsIncludeFileName=target_mem.h
    5 x OsMemoryRegion:
      INTROM_PE1: OsMemoryRegionWriteable=false, OsMemoryRegionStartAddress=0, OsMemoryRegionSize=4*1024*1024, OsMemoryRegionName=INTROM_PE1
      INTROM_PE2: OsMemoryRegionWriteable=false, OsMemoryRegionStartAddress=8388608, OsMemoryRegionSize=2*1024*1024, OsMemoryRegionName=INTROM_PE2
      INTRAM_PE1: OsMemoryRegionWriteable=true, OsMemoryRegionStartAddress=4273799168, OsMemoryRegionSize=192*1024, OsMemoryRegionName=INTRAM_PE1
      INTRAM_PE2: OsMemoryRegionWriteable=true, OsMemoryRegionStartAddress=4271702016, OsMemoryRegionSize=192*1024, OsMemoryRegionName=INTRAM_PE2
      INTRAM: OsMemoryRegionWriteable=true, OsMemoryRegionStartAddress=4277141504, OsMemoryRegionSize=128*1024, OsMemoryRegionName=INTRAM
    STANDARDREGION_SYSTEM (OsStandardMemoryRegion): OsStandardMemoryRomRegionRef=INTROM_PE1, OsStandardMemoryRamRegionRef=INTRAM
