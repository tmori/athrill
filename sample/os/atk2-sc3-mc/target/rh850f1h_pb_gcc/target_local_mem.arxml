AUTOSAR XML (schema 4-0-3)
package /Ecuc
  module config Os: ecuc-def-edition=4.2.0, implementation-config-variant=VARIANT-PRE-COMPILE
    STANDARDREGION_PE1 (OsStandardMemoryRegion): OsStandardMemoryCoreAssignment=0, OsStandardMemoryRomRegionRef=INTROM_PE1, OsStandardMemoryRamRegionRef=INTRAM_PE1
    STANDARDREGION_PE2 (OsStandardMemoryRegion): OsStandardMemoryCoreAssignment=1, OsStandardMemoryRomRegionRef=INTROM_PE2, OsStandardMemoryRamRegionRef=INTRAM_PE2
