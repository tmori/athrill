AUTOSAR XML (schema 4-0-3)
package /Ecuc
  module config Os: ecuc-def-edition=4.2.0, implementation-config-variant=VARIANT-PRE-COMPILE
    target_timer_hdr (OsIsr): OsIsrInterruptNumber=OSTM_IRQ, OsIsrInterruptPriority=INTPRI_TIMER, OsIsrStackSize=592, OsIsrCategory=CATEGORY_2
    SysTimerCnt (OsCounter): OsCounterMaxAllowedValue=999, OsCounterMinCycle=1, OsCounterTicksPerBase=1, OsCounterType=SOFTWARE
