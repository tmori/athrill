AUTOSAR XML (schema 4-0-3)
package /Ecuc
  module config Os: ecuc-def-edition=4.2.0, implementation-config-variant=VARIANT-PRE-COMPILE
    TRUSTED_OSAP_for_RxHwSerialInt (OsApplication): OsTrusted=true, OsAppIsrRef=RxHwSerialInt
      OsApplicationHooks: OsAppErrorHook=false, OsAppShutdownHook=false, OsAppStartupHook=false
    RxHwSerialInt (OsIsr): OsIsrInterruptNumber=INTNO_SIO, OsIsrInterruptPriority=INTPRI_SIO, OsIsrStackSize=592, OsIsrCategory=CATEGORY_2, OsIsrInterruptSource=ENABLE
