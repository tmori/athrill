AUTOSAR XML (schema 4-0-3)
standard types defined: uint8
package /Ecuc
  module config Os: ecuc-def-edition=4.2.0, implementation-config-variant=VARIANT-PRE-COMPILE
    NT_osap2 (OsApplication):
      OsTrusted = false
      OsAppAlarmRef = ActOtherOSAPTskArm
      OsAppCounterRef = ActOtherOSAPTskArmCnt
      OsAppTaskRef = Task8
      OsAppTaskRef = Task9
      OsAppTaskRef = IocTask2
    OsLinkSection: OsLinkSectionName=.stack_section, OsLinkSectionMemoryRegionRef=INTRAM
    NT_osap1 (OsApplication):
      OsTrusted = false
      OsAppAlarmRef = MainCycArm
      OsAppAlarmRef = ActTskArm
      OsAppAlarmRef = SetEvtArm
      OsAppAlarmRef = SampleAlm1
      OsAppAlarmRef = SampleAlm2
      OsAppTaskRef = HighPriorityTask
      OsAppTaskRef = Task{1..5}
      OsAppTaskRef = Task{10..14}
      OsAppTaskRef = IocTask1
      OsAppCounterRef = SampleCnt
      OsAppCounterRef = SchtblSampleCnt
      OsAppCounterRef = SampleCnt2
      OsAppCounterRef = SampleCnt3
      OsAppScheduleTableRef = scheduletable1
      OsAppScheduleTableRef = scheduletable2
    3 x OsAppMode:
      AppMode3
      AppMode2
      AppMode1
    ActTskArm (OsAlarm): OsAlarmCounterRef=MAIN_HW_COUNTER
      OsAlarmAction
        OsAlarmActivateTask: OsAlarmActivateTaskRef=Task1
    CntRes (OsResource): OsResourceProperty=STANDARD, OsResourceAccessingApplication=NT_osap1
    T11Evt (OsEvent)
    ActOtherOSAPTskArmCnt (OsCounter): OsCounterType=SOFTWARE, OsCounterMinCycle=10, OsCounterTicksPerBase=10, OsCounterMaxAllowedValue=99
    OsOS: OsUseGetServiceId=true, OsScalabilityClass=SC3, OsStackMonitoring=true, OsStatus=EXTENDED, OsUseParameterAccess=true
      OsHooks: OsPreTaskHook=true, OsErrorHook=true, OsShutdownHook=true, OsPostTaskHook=true, OsProtectionHook=true, OsStartupHook=true
      OsHookStack: OsHookStackSize=512
    Task9 (OsTask): OsTaskStackSize=768, OsTaskSchedule=FULL, OsTaskSystemStackSize=512, OsTaskActivation=5, OsTaskPriority=8
    Task8 (OsTask): OsTaskStackSize=592, OsTaskSchedule=FULL, OsTaskSystemStackSize=512, OsTaskActivation=5, OsTaskPriority=8
    T12Evt (OsEvent)
    T2Evt (OsEvent)
    7 x OsTask, all with OsTaskStackSize=512, OsTaskSchedule=FULL:
      Task5: OsTaskSystemStackSize=512, OsTaskActivation=5, OsTaskPriority=9, OsTaskResourceRef=GroupRes, OsTaskResourceRef=CntRes, OsTaskResourceRef=TskLevelRes
      Task4: OsTaskSystemStackSize=512, OsTaskActivation=5, OsTaskPriority=6, OsTaskResourceRef=GroupRes, OsTaskResourceRef=CntRes, OsTaskResourceRef=TskLevelRes, OsTaskAccessingApplication=NT_osap2
      Task3: OsTaskSystemStackSize=512, OsTaskActivation=1, OsTaskPriority=12, OsTaskEventRef=T3Evt, OsTaskResourceRef=CntRes
        OsTaskAutostart: OsTaskAppModeRef=AppMode3
      Task2: OsTaskSystemStackSize=512, OsTaskActivation=1, OsTaskPriority=7, OsTaskEventRef=T2Evt, OsTaskResourceRef=CntRes, OsTaskResourceRef=TskLevelRes, OsTaskAccessingApplication=NT_osap2
      Task1: OsTaskSystemStackSize=512, OsTaskActivation=8, OsTaskPriority=4, OsTaskResourceRef=CntRes, OsTaskResourceRef=TskLevelRes
        OsTaskAutostart: OsTaskAppModeRef=AppMode2
      Task7: OsTaskStackStartAddress=stack_00, OsTaskActivation=5, OsTaskPriority=8, OsTaskAccessingApplication=NT_osap1
      Task6: OsTaskStackStartAddress=stack_00, OsTaskActivation=5, OsTaskPriority=9
    IOC (OsIoc)
      IOC_DEQUE (OsIocCommunication)
        IOC_DEQUE_SND (OsIocSenderProperties): OsIocFunctionImplementationKind=FUNCTION, OsIocSendingOsApplicationRef=KT_osap1
        IOC_DEQUE_RCV (OsIocReceiverProperties): OsIocFunctionImplementationKind=FUNCTION, OsIocReceivingOsApplicationRef=KT_osap2
        3 x OsIocDataProperties, all with OsIocDataTypeRef=uint8:
          IOC_DEQUE_DATA2: OsIocDataPropertyIndex=2, OsIocInitValue=20U
          IOC_DEQUE_DATA1: OsIocDataPropertyIndex=1, OsIocInitValue=10U
          IOC_DEQUE_DATA0: OsIocDataPropertyIndex=0, OsIocInitValue=0U
      IOC_QUE (OsIocCommunication): OsIocBufferLength=3
        IOC_QUE_DATA (OsIocDataProperties): OsIocInitValue=1U, OsIocDataTypeRef=uint8
        IOC_QUE_SND1 (OsIocSenderProperties): OsIocFunctionImplementationKind=FUNCTION, OsIocSenderId=1, OsIocSendingOsApplicationRef=KT_osap1
        IOC_QUE_SND0 (OsIocSenderProperties): OsIocFunctionImplementationKind=FUNCTION, OsIocSenderId=0, OsIocSendingOsApplicationRef=NT_osap1
        IOC_QUE_RCV (OsIocReceiverProperties): OsIocFunctionImplementationKind=FUNCTION, OsIocReceivingOsApplicationRef=NT_osap2
    4 x OsTask, all with OsTaskStackSize=512, OsTaskSchedule=FULL, OsTaskSystemStackSize=512, OsTaskActivation=1, OsTaskPriority=9:
      IocTask4
      IocTask3
      IocTask2: OsTaskAccessingApplication=NT_osap1
      IocTask1: OsTaskAccessingApplication=NT_osap2
    SampleCnt (OsCounter): OsCounterType=SOFTWARE, OsCounterMinCycle=10, OsCounterTicksPerBase=10, OsCounterMaxAllowedValue=99
    GroupRes (OsResource): OsResourceProperty=INTERNAL, OsResourceAccessingApplication=NT_osap1
    5 x OsTask, all with OsTaskStackSize=512, OsTaskSystemStackSize=512:
      Task14: OsTaskSchedule=FULL, OsTaskStackStartAddress=stack_1, OsTaskActivation=5, OsTaskPriority=8, OsTaskSystemStackStartAddress=stack_2
      Task13: OsTaskSchedule=FULL, OsTaskStackStartAddress=stack_1, OsTaskActivation=5, OsTaskPriority=9, OsTaskSystemStackStartAddress=stack_2
      Task12: OsTaskSchedule=NON, OsTaskActivation=1, OsTaskPriority=13, OsTaskEventRef=T12Evt
      Task11: OsTaskSchedule=NON, OsTaskActivation=1, OsTaskPriority=13, OsTaskEventRef=T11Evt
      Task10: OsTaskSchedule=NON, OsTaskActivation=1, OsTaskPriority=13, OsTaskEventRef=T10Evt
    SampleCnt3 (OsCounter): OsCounterType=SOFTWARE, OsCounterMinCycle=10, OsCounterTicksPerBase=10, OsCounterMaxAllowedValue=99
    SampleCnt2 (OsCounter): OsCounterType=SOFTWARE, OsCounterMinCycle=10, OsCounterTicksPerBase=10, OsCounterMaxAllowedValue=99
    OsInclude2 (OsInclude): OsIncludeFileName=sample2.h
    OsInclude1 (OsInclude): OsIncludeFileName=sample1.h
    MainEvt (OsEvent)
    scheduletable2 (OsScheduleTable): OsScheduleTableRepeating=true, OsScheduleTableDuration=50, OsScheduleTableCounterRef=SchtblSampleCnt
      3 x OsScheduleTableExpiryPoint:
        OsScheduleTableExpiryPoint_2: OsScheduleTblExpPointOffset=40
          OsScheduleTableEventSetting_0 (OsScheduleTableEventSetting): OsScheduleTableSetEventTaskRef=Task11, OsScheduleTableSetEventRef=T11Evt
        OsScheduleTableExpiryPoint_1: OsScheduleTblExpPointOffset=30
          OsScheduleTableEventSetting_0 (OsScheduleTableEventSetting): OsScheduleTableSetEventTaskRef=Task12, OsScheduleTableSetEventRef=T12Evt
        OsScheduleTableExpiryPoint_0: OsScheduleTblExpPointOffset=20
          OsScheduleTableTaskActivation_1 (OsScheduleTableTaskActivation): OsScheduleTableActivateTaskRef=Task11
          OsScheduleTableTaskActivation_0 (OsScheduleTableTaskActivation): OsScheduleTableActivateTaskRef=Task12
      OsScheduleTableSync: OsScheduleTblSyncStrategy=NONE
    scheduletable1 (OsScheduleTable): OsScheduleTableRepeating=true, OsScheduleTableDuration=60, OsScheduleTableCounterRef=SchtblSampleCnt
      OsScheduleTableExpiryPoint_1 (OsScheduleTableExpiryPoint): OsScheduleTblExpPointOffset=20
        3 x OsScheduleTableEventSetting:
          OsScheduleTableEventSetting_2: OsScheduleTableSetEventTaskRef=Task12, OsScheduleTableSetEventRef=T12Evt
          OsScheduleTableEventSetting_1: OsScheduleTableSetEventTaskRef=Task11, OsScheduleTableSetEventRef=T11Evt
          OsScheduleTableEventSetting_0: OsScheduleTableSetEventTaskRef=Task10, OsScheduleTableSetEventRef=T10Evt
      OsScheduleTableExpiryPoint_0 (OsScheduleTableExpiryPoint): OsScheduleTblExpPointOffset=10
        3 x OsScheduleTableTaskActivation:
          OsScheduleTableTaskActivation_2: OsScheduleTableActivateTaskRef=Task12
          OsScheduleTableTaskActivation_1: OsScheduleTableActivateTaskRef=Task11
          OsScheduleTableTaskActivation_0: OsScheduleTableActivateTaskRef=Task10
      OsScheduleTableSync: OsScheduleTblSyncStrategy=NONE
    banner (OsMemoryModule): OsMemoryModuleExport=false, OsMemoryModuleName=banner.o
    T3Evt (OsEvent): OsEventMask=65536
    MainCycArm (OsAlarm): OsAlarmCounterRef=MAIN_HW_COUNTER
      OsAlarmAction
        OsAlarmSetEvent: OsAlarmSetEventTaskRef=MainTask, OsAlarmSetEventRef=MainEvt
    HighPriorityTask (OsTask): OsTaskStackSize=512, OsTaskSchedule=FULL, OsTaskSystemStackSize=512, OsTaskActivation=1, OsTaskPriority=15
    log_output (OsMemoryModule): OsMemoryModuleExport=false, OsMemoryModuleName=log_output.o
    SchtblSampleCnt (OsCounter): OsCounterType=SOFTWARE, OsCounterMinCycle=10, OsCounterTicksPerBase=10, OsCounterMaxAllowedValue=99
    TskLevelRes (OsResource): OsResourceProperty=STANDARD, OsResourceAccessingApplication=NT_osap1
    ActOtherOSAPTskArm (OsAlarm): OsAlarmCounterRef=ActOtherOSAPTskArmCnt
      OsAlarmAction
        OsAlarmActivateTask: OsAlarmActivateTaskRef=Task4
      OsAlarmAutostart:
        OsAlarmAutostartType = ABSOLUTE
        OsAlarmCycleTime = 0
        OsAlarmAlarmTime = 5
        OsAlarmAppModeRef = AppMode{1..3}
    sample1 (OsMemoryModule): OsMemoryModuleExport=false, OsMemoryModuleName=sample1.o
    KT_osap2 (OsApplication): OsTrusted=true, OsAppTaskRef=IocTask4
      actioctask4 (OsApplicationTrustedFunction): OsTrustedFunctionName=TRUSTED_actioctask4, OsTrustedFunctionStackSize=32
    KT_osap1 (OsApplication):
      OsTrusted = true
      OsAppTaskRef = MainTask
      OsAppTaskRef = NonPriTask
      OsAppTaskRef = Task6
      OsAppTaskRef = Task7
      OsAppTaskRef = IocTask3
      OsAppMemoryModuleRef = banner
      OsAppMemoryModuleRef = log_output
      OsAppMemoryModuleRef = sample1
      5 x OsApplicationTrustedFunction, all with OsTrustedFunctionStackSize=32:
        tfnt4: OsTrustedFunctionName=TRUSTED_tfnt4
        tfnt3: OsTrustedFunctionName=TRUSTED_tfnt3
        tfnt2: OsTrustedFunctionName=TRUSTED_tfnt2
        tfnt1: OsTrustedFunctionName=TRUSTED_tfnt1
        actioctask3: OsTrustedFunctionName=TRUSTED_actioctask3
    T10Evt (OsEvent)
    SetEvtArm (OsAlarm): OsAlarmCounterRef=MAIN_HW_COUNTER
      OsAlarmAction
        OsAlarmSetEvent: OsAlarmSetEventTaskRef=Task3, OsAlarmSetEventRef=T3Evt
    MainTask (OsTask):
      OsTaskStackSize = 512
      OsTaskSchedule = NON
      OsTaskSystemStackSize = 512
      OsTaskActivation = 1
      OsTaskPriority = 14
      OsTaskEventRef = MainEvt
      OsTaskAccessingApplication = NT_osap1
      OsTaskAutostart: OsTaskAppModeRef=AppMode1, OsTaskAppModeRef=AppMode2, OsTaskAppModeRef=AppMode3
    SampleAlm2 (OsAlarm): OsAlarmCounterRef=SampleCnt3
      OsAlarmAction
        OsAlarmSetEvent: OsAlarmSetEventTaskRef=MainTask, OsAlarmSetEventRef=MainEvt
      OsAlarmAutostart:
        OsAlarmAutostartType = ABSOLUTE
        OsAlarmCycleTime = 10
        OsAlarmAlarmTime = 10
        OsAlarmAppModeRef = AppMode{1..3}
    SampleAlm1 (OsAlarm): OsAlarmCounterRef=SampleCnt2
      OsAlarmAction
        OsAlarmIncrementCounter: OsAlarmIncrementCounterRef=SampleCnt3
      OsAlarmAutostart:
        OsAlarmAutostartType = ABSOLUTE
        OsAlarmCycleTime = 10
        OsAlarmAlarmTime = 10
        OsAlarmAppModeRef = AppMode{1..3}
    NonPriTask (OsTask): OsTaskStackSize=512, OsTaskSchedule=NON, OsTaskSystemStackSize=512, OsTaskActivation=8, OsTaskPriority=1
