AUTOSAR XML (schema 4-0-3)
package /Ecuc
  module config Os: ecuc-def-edition=4.2.0, implementation-config-variant=VARIANT-PRE-COMPILE
    OsInclude: OsIncludeFileName=target_mem.h
    4 x OsMemoryRegion:
      INTROM_PE1: OsMemoryRegionWriteable=false, OsMemoryRegionStartAddress=0, OsMemoryRegionSize=4*1024*1024, OsMemoryRegionName=INTROM_PE1
      INTROM_PE2: OsMemoryRegionWriteable=false, OsMemoryRegionStartAddress=8388608, OsMemoryRegionSize=2*1024*1024, OsMemoryRegionName=INTROM_PE2
      INTRAM: OsMemoryRegionWriteable=true, OsMemoryRegionStartAddress=4273799168, OsMemoryRegionSize=192*1024, OsMemoryRegionName=INTRAM
      INTRAM2: OsMemoryRegionWriteable=true, OsMemoryRegionStartAddress=268435456, OsMemoryRegionSize=192*1024, OsMemoryRegionName=INTRAM2
