AUTOSAR XML (schema 4-0-3)
package /Ecuc
  module config Os: ecuc-def-edition=4.2.0, implementation-config-variant=VARIANT-PRE-COMPILE
    OsInclude: OsIncludeFileName=target_hw_counter.h
    TRUSTED_OSAP_for_MAIN_HW_COUNTER (OsApplication): OsTrusted=true, OsAppCounterRef=MAIN_HW_COUNTER, OsAppIsrRef=C2ISR_for_MAIN_HW_COUNTER
    MAIN_HW_COUNTER (OsCounter):
      OsCounterMaxAllowedValue = 536870911
      OsCounterMinCycle = 4000
      OsCounterTicksPerBase = 10
      OsSecondsPerTick = 1.25e-07
      OsCounterType = HARDWARE
      OsCounterIsrRef = C2ISR_for_MAIN_HW_COUNTER
    C2ISR_for_MAIN_HW_COUNTER (OsIsr): OsIsrInterruptNumber=HWC_DTIM_INTNO, OsIsrInterruptPriority=HWC_DTIM_INTPRI, OsIsrCategory=CATEGORY_2, OsIsrInterruptSource=ENABLE
