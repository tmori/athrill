AUTOSAR XML (schema 4-0-3)
package /Ecuc
  module config Os: ecuc-def-edition=4.2.0, implementation-config-variant=VARIANT-PRE-COMPILE
    STANDARDREGION (OsStandardMemoryRegion): OsStandardMemoryRomRegionRef=INTROM_PE1, OsStandardMemoryRamRegionRef=INTRAM
    NON_USE_PE_ROM (OsMemorySection):
      OsMemorySectionName = .non_use_pe_rom
      OsMemorySectionWriteable = false
      OsMemorySectionReadable = true
      OsMemorySectionExecutable = true
      OsMemorySectionShort = false
      OsMemorySectionCacheable = false
      OsMemorySectionDevice = false
      OsMemorySectionExport = false
      OsMemorySectionMemoryRegionRef = INTROM_PE2
    TRUSTED_OSAP_for_NON_USE_PE_ROM (OsApplication): OsTrusted=true, OsAppMemorySectionRef=NON_USE_PE_ROM
      OsApplicationHooks: OsAppErrorHook=false, OsAppShutdownHook=false, OsAppStartupHook=false
